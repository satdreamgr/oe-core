## meta-satdreamgr/conf/layer.conf
```bitbake
# We have a recipes directory, add to BBFILES
BBFILES += "${LAYERDIR}/recipes-*/*/*.bb ${LAYERDIR}/recipes-*/*/*.bbappend"

BBFILE_COLLECTIONS += "sdg-layer"
BBFILE_PATTERN_sdg-layer := "^${LAYERDIR}/"
BBFILE_PRIORITY_sdg-layer = "50"
```
